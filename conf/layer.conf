## conf/layer.conf
```bitbake
# We have a conf and classes directory, add to BBPATH
BBPATH .= ":${LAYERDIR}"

# We have recipes-* directories, add to BBFILES
BBFILES += "${LAYERDIR}/recipes-*/*/*.bb \
            ${LAYERDIR}/recipes-*/*/*.bbappend"

BBFILE_COLLECTIONS += "hfp"
BBFILE_PATTERN_hfp = "^${LAYERDIR}/"
BBFILE_PRIORITY_hfp = "10"

LAYERVERSION_hfp = "1"
LAYERDEPENDS_hfp = "core openembedded-layer qt4-layer raspberrypi "
LAYERSERIES_COMPAT_hfp = "thud"
```
